LOAD_ADDR = 0x200000 + SIZEOF_HEADERS;
LINK_ADDR = 0x200000 + SIZEOF_HEADERS;
VIRT_TO_PHYS = LINK_ADDR - LOAD_ADDR;

ENTRY(_start)
SECTIONS
{
	. = LINK_ADDR;

	kernel_start = . - SIZEOF_HEADERS;
	kernel_phys_start = . - VIRT_TO_PHYS - SIZEOF_HEADERS;

	.text : AT(ADDR(.text) - VIRT_TO_PHYS)
	{
		*(.text)
	}
	.rodata ALIGN(4096) : AT(ADDR(.rodata) - VIRT_TO_PHYS)
	{
		*(.rodata)
	}
	.data ALIGN(4096) : AT(ADDR(.data) - VIRT_TO_PHYS)
	{
		*(.data)
	}
	.bss ALIGN(4096) : AT(ADDR(.bss) - VIRT_TO_PHYS)
	{
		*(.bss)
	}

	. = ALIGN(4096);

	kernel_end = .;
	kernel_phys_end = . - VIRT_TO_PHYS;

	kernel_size = kernel_end - kernel_start;
}
